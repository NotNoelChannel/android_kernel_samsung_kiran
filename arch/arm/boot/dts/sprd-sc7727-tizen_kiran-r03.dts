/* Copyright (c) 2014, The Linux Foundation. All rights reserved.
*
* This program is free software; you can redistribute it and/or modify
* it under the terms of the GNU General Public License version 2 and
* only version 2 as published by the Free Software Foundation.
*
* This program is distributed in the hope that it will be useful,
* but WITHOUT ANY WARRANTY; without even the implied warranty of
* MERCHANTABILITY or FITNESS FOR A PARTICULAR PURPOSE.  See the
* GNU General Public License for more details.
*/

/dts-v1/;

#include "sprd-sc7727-tizen_kiran-r03.dtsi"

/ {
	model = "Samsung Kiran PROJECT Rev03";
	compatible = "sprd,sp8835eb";
	sprd,sc-id = <0x00001E2F 3 0>;
	sprd,board-id = <0x00001E2F 3>;
};

